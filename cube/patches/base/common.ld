INCLUDE ../reservedarea.ld

CP  = 0xCC000000;
PE  = 0xCC001000;
VI  = 0xCC002000;
PI  = 0xCC003000;
MI  = 0xCC004000;
DSP = 0xCC005000;
DI  = 0xCC006000;
SI  = 0xCC006400;
EXI = 0xCC006800;
AI  = 0xCC006C00;

CPEmuRegs  = 0x0C000000;
PEEmuRegs  = 0x0C001000;
VIEmuRegs  = 0x0C002000;
PIEmuRegs  = 0x0C003000;
MIEmuRegs  = 0x0C004000;
DSPEmuRegs = 0x0C005000;
DIEmuRegs  = 0x0C006000;
SIEmuRegs  = 0x0C006400;
EXIEmuRegs = 0x0C006800;
AIEmuRegs  = 0x0C006C00;
